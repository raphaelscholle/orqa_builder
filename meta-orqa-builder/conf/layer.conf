## meta-orqa-builder/conf/layer.conf
```bitbake
BBPATH .= ":${LAYERDIR}"
BBFILES += "${LAYERDIR}/recipes-*/*/*.bb \
            ${LAYERDIR}/recipes-*/*/*.bbappend"

BBFILE_COLLECTIONS += "orqa-builder"
BBFILE_PATTERN_orqa-builder = "^${LAYERDIR}/"
BBFILE_PRIORITY_orqa-builder = "9"

LAYERSERIES_COMPAT_orqa-builder = "kirkstone scarthgap"
```
